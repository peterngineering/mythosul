## configs/asus_tinker_rk3288_defconfig
```kconfig
BR2_arm=y
BR2_cortex_a17=y
BR2_ARM_FPU_NEON_VFPV4=y
BR2_PACKAGE_HOST_LINUX_HEADERS_CUSTOM_6_12=y
BR2_TOOLCHAIN_BUILDROOT_CXX=y
BR2_OPTIMIZE_S=y
BR2_ENABLE_LTO=y
BR2_TARGET_GENERIC_HOSTNAME="mythosul-v35-build41"
BR2_TARGET_GENERIC_ISSUE="Welcome to MythOSUL"
BR2_ROOTFS_DEVICE_CREATION_DYNAMIC_EUDEV=y
BR2_ROOTFS_MERGED_USR=y
BR2_TARGET_GENERIC_ROOT_PASSWD="1234"
BR2_SYSTEM_DHCP="eth0"
BR2_SYSTEM_DEFAULT_PATH="/bin:/sbin:/usr/bin:/usr/sbin"
BR2_TARGET_TZ_INFO=y
BR2_TARGET_LOCALTIME="US/Eastern"
BR2_ROOTFS_USERS_TABLES="board/asus/tinker/user_tables.txt"
BR2_ROOTFS_OVERLAY="board/asus/tinker/arm/overlay"
BR2_ROOTFS_POST_BUILD_SCRIPT="board/asus/tinker/post-build.sh"
BR2_ROOTFS_POST_IMAGE_SCRIPT="support/scripts/genimage.sh"
BR2_ROOTFS_POST_SCRIPT_ARGS="-c board/asus/tinker/genimage.cfg"
BR2_LINUX_KERNEL=y
BR2_LINUX_KERNEL_CUSTOM_VERSION=y
BR2_LINUX_KERNEL_CUSTOM_VERSION_VALUE="6.12.51"
BR2_LINUX_KERNEL_USE_CUSTOM_CONFIG=y
BR2_LINUX_KERNEL_CUSTOM_CONFIG_FILE="board/asus/tinker/TINKER_KERNEL_CONFIG/.config"
BR2_LINUX_KERNEL_DTS_SUPPORT=y
BR2_LINUX_KERNEL_DTB_IS_SELF_BUILT=y
BR2_LINUX_KERNEL_INTREE_DTS_NAME="rk3288-tinker"
BR2_LINUX_KERNEL_DTB_OVERLAY_SUPPORT=y
BR2_LINUX_KERNEL_INSTALL_TARGET=y
BR2_LINUX_KERNEL_NEEDS_HOST_OPENSSL=y
BR2_PACKAGE_ALSA_UTILS=y
BR2_PACKAGE_ALSA_UTILS_ALSACONF=y
BR2_PACKAGE_ALSA_UTILS_AMIXER=y
BR2_PACKAGE_ALSA_UTILS_APLAY=y
BR2_PACKAGE_ALSA_UTILS_IECSET=y
BR2_PACKAGE_ALSA_UTILS_SPEAKER_TEST=y
BR2_PACKAGE_JACK1=y
BR2_PACKAGE_LAME=y
BR2_PACKAGE_MYTHTV=y
BR2_PACKAGE_MYTHTV_GPL=y
BR2_PACKAGE_MYTHTV_NONFREE=y
BR2_PACKAGE_MYTHTV_FFMPEG=y
BR2_PACKAGE_MYTHTV_FFMPEG_FFPLAY=y
BR2_PACKAGE_MYTHTV_FFMPEG_FFPROBE=y
BR2_PACKAGE_MYTHTV_INPUT_JOYSTICK_MENU=y
BR2_PACKAGE_MYTHTV_INPUT_LIRC=y
BR2_PACKAGE_LIBCEC=y
BR2_PACKAGE_LIBV4L=y
BR2_PACKAGE_MYTHTV_INPUT_SATIP=y
BR2_PACKAGE_MYTHTV_INPUT_FIREWIRE=y
BR2_PACKAGE_MYTHTV_INPUT_DVB=y
BR2_PACKAGE_LIBHDHOMERUN=y
BR2_PACKAGE_MYTHTV_INPUT_VBOX=y
BR2_PACKAGE_MYTHTV_INPUT_CETON=y
BR2_PACKAGE_MYTHTV_INPUT_ASI=y
BR2_PACKAGE_MYTHTV_VIDEO_OUTPUT_MHEG=y
BR2_PACKAGE_LIBASS=y
BR2_PACKAGE_PULSEAUDIO=y
BR2_PACKAGE_LIBBLURAY=y
BR2_PACKAGE_MYTHTV_EXTERNAL_CODEC_OPTIONS=y
BR2_PACKAGE_X264=y
BR2_PACKAGE_DOSFSTOOLS=y
BR2_PACKAGE_DOSFSTOOLS_FSCK_FAT=y
BR2_PACKAGE_DOSFSTOOLS_MKFS_FAT=y
BR2_PACKAGE_E2FSPROGS_RESIZE2FS=y
BR2_PACKAGE_LIBERATION=y
# BR2_PACKAGE_LIBERATION_MONO is not set
# BR2_PACKAGE_LIBERATION_SERIF is not set
BR2_PACKAGE_KMSCUBE=y
BR2_PACKAGE_MESA3D=y
BR2_PACKAGE_MESA3D_LLVM=y
BR2_PACKAGE_MESA3D_GALLIUM_DRIVER_KMSRO=y
BR2_PACKAGE_MESA3D_GALLIUM_DRIVER_PANFROST=y
BR2_PACKAGE_MESA3D_OPENGL_EGL=y
BR2_PACKAGE_SDL2_KMSDRM=y
BR2_PACKAGE_SDL2_OPENGLES=y
BR2_PACKAGE_QT5=y
BR2_PACKAGE_QT5BASE_SQLITE_QT=y
BR2_PACKAGE_QT5BASE_OPENGL_LIB=y
BR2_PACKAGE_QT5BASE_LINUXFB=y
BR2_PACKAGE_QT5BASE_JPEG=y
BR2_PACKAGE_QT5BASE_PNG=y
BR2_PACKAGE_QT5BASE_DBUS=y
BR2_PACKAGE_LINUX_FIRMWARE=y
BR2_PACKAGE_LINUX_FIRMWARE_ATHEROS_7010=y
BR2_PACKAGE_LINUX_FIRMWARE_ATHEROS_9170=y
BR2_PACKAGE_LINUX_FIRMWARE_ATHEROS_9271=y
BR2_PACKAGE_LINUX_FIRMWARE_RTL_81XX=y
BR2_PACKAGE_LINUX_FIRMWARE_RTL_87XX=y
BR2_PACKAGE_LINUX_FIRMWARE_RTL_88XX=y
BR2_PACKAGE_LINUX_FIRMWARE_RTL_815X=y
BR2_PACKAGE_LINUX_FIRMWARE_XCx000=y
BR2_PACKAGE_LINUX_FIRMWARE_CX231XX=y
BR2_PACKAGE_MARIADB_SERVER=y
BR2_PACKAGE_LIBDRM_INSTALL_TESTS=y
BR2_PACKAGE_LIBINPUT=y
BR2_PACKAGE_LIBXKBCOMMON=y
BR2_PACKAGE_LIBXKBCOMMON_TOOLS=y
BR2_PACKAGE_LIBDVDNAV=y
BR2_PACKAGE_AVAHI=y
BR2_PACKAGE_AVAHI_DAEMON=y
BR2_PACKAGE_CHRONY=y
BR2_PACKAGE_DNSMASQ=y
BR2_PACKAGE_ETHTOOL=y
BR2_PACKAGE_HOSTAPD=y
BR2_PACKAGE_HOSTAPD_WPS=y
BR2_PACKAGE_HOSTAPD_WPA3=y
BR2_PACKAGE_IPTABLES=y
BR2_PACKAGE_IPUTILS=y
BR2_PACKAGE_IW=y
BR2_PACKAGE_LIGHTTPD=y
BR2_PACKAGE_NMAP=y
BR2_PACKAGE_NTP=y
BR2_PACKAGE_NTP_SNTP=y
# BR2_PACKAGE_NTP_NTPD is not set
BR2_PACKAGE_NTP_NTPDATE=y
BR2_PACKAGE_OPENSSH=y
BR2_PACKAGE_RSYNC=y
BR2_PACKAGE_SAMBA4=y
BR2_PACKAGE_WIRELESS_REGDB=y
BR2_PACKAGE_WIRELESS_TOOLS=y
BR2_PACKAGE_WIRELESS_TOOLS_LIB=y
BR2_PACKAGE_WPA_SUPPLICANT=y
BR2_PACKAGE_WPA_SUPPLICANT_WEXT=y
BR2_PACKAGE_WPA_SUPPLICANT_AUTOSCAN=y
BR2_PACKAGE_WPA_SUPPLICANT_EAP=y
BR2_PACKAGE_WPA_SUPPLICANT_WPS=y
BR2_PACKAGE_WPA_SUPPLICANT_WPA3=y
BR2_PACKAGE_WPA_SUPPLICANT_CLI=y
BR2_PACKAGE_WPA_SUPPLICANT_WPA_CLIENT_SO=y
BR2_PACKAGE_WPA_SUPPLICANT_PASSPHRASE=y
BR2_PACKAGE_WPA_SUPPLICANT_DBUS=y
BR2_PACKAGE_FILE=y
BR2_PACKAGE_LOGROTATE=y
BR2_PACKAGE_SCREEN=y
BR2_PACKAGE_SUDO=y
BR2_PACKAGE_HTOP=y
BR2_PACKAGE_UTIL_LINUX_BINARIES=y
BR2_PACKAGE_UTIL_LINUX_AGETTY=y
BR2_PACKAGE_UTIL_LINUX_PARTX=y
BR2_PACKAGE_NANO=y
BR2_TARGET_ROOTFS_EXT2=y
BR2_TARGET_ROOTFS_EXT2_4=y
BR2_TARGET_ROOTFS_EXT2_SIZE="800M"
BR2_TARGET_ROOTFS_EXT2_RESBLKS=1
BR2_TARGET_UBOOT=y
BR2_TARGET_UBOOT_BUILD_SYSTEM_KCONFIG=y
BR2_TARGET_UBOOT_CUSTOM_VERSION=y
BR2_TARGET_UBOOT_CUSTOM_VERSION_VALUE="2023.07"
BR2_TARGET_UBOOT_BOARD_DEFCONFIG="tinker-rk3288"
BR2_TARGET_UBOOT_NEEDS_DTC=y
BR2_TARGET_UBOOT_NEEDS_PYLIBFDT=y
BR2_TARGET_UBOOT_NEEDS_OPENSSL=y
BR2_TARGET_UBOOT_FORMAT_DTB_IMG=y
BR2_TARGET_UBOOT_SPL=y
BR2_TARGET_UBOOT_SPL_NAME="spl/u-boot-spl-dtb.bin tpl/u-boot-tpl.bin"
BR2_PACKAGE_HOST_DOSFSTOOLS=y
BR2_PACKAGE_HOST_GENIMAGE=y
BR2_PACKAGE_HOST_MTOOLS=y
BR2_PACKAGE_HOST_UBOOT_TOOLS=y
```

## configs/pc_x86_64_efi_defconfig
```kconfig
BR2_x86_64=y
BR2_PACKAGE_HOST_LINUX_HEADERS_CUSTOM_6_1=y
BR2_BINUTILS_VERSION_2_44_X=y
BR2_GCC_VERSION_14_X=y
BR2_TOOLCHAIN_BUILDROOT_CXX=y
BR2_CCACHE=y
BR2_CCACHE_DIR="$(TOPDIR)/.buildroot-ccache"
BR2_OPTIMIZE_S=y
BR2_ENABLE_LTO=y
BR2_DOWNLOAD_FORCE_CHECK_HASHES=y
BR2_TARGET_GENERIC_HOSTNAME="mythosul-v35-build42"
BR2_TARGET_GENERIC_ISSUE="Welcome to MythOSUL"
BR2_INIT_SYSTEMD=y
BR2_TARGET_GENERIC_ROOT_PASSWD="1234"
BR2_TARGET_GENERIC_GETTY_PORT="tty1"
BR2_SYSTEM_DEFAULT_PATH="/bin:/sbin:/usr/bin:/usr/sbin"
# BR2_ENABLE_LOCALE_PURGE is not set
BR2_SYSTEM_ENABLE_NLS=y
BR2_TARGET_LOCALTIME="US/Eastern"
BR2_ROOTFS_USERS_TABLES="board/pc/user_tables.txt"
BR2_ROOTFS_OVERLAY="board/pc/overlay"
BR2_ROOTFS_POST_BUILD_SCRIPT="board/pc/post-build.sh"
BR2_ROOTFS_POST_IMAGE_SCRIPT="board/pc/post-image-efi.sh"
BR2_LINUX_KERNEL=y
BR2_LINUX_KERNEL_CUSTOM_VERSION=y
BR2_LINUX_KERNEL_CUSTOM_VERSION_VALUE="6.1.159"
BR2_LINUX_KERNEL_USE_CUSTOM_CONFIG=y
BR2_LINUX_KERNEL_CUSTOM_CONFIG_FILE="board/pc/linux.config"
BR2_LINUX_KERNEL_INSTALL_TARGET=y
BR2_LINUX_KERNEL_NEEDS_HOST_OPENSSL=y
BR2_LINUX_KERNEL_NEEDS_HOST_LIBELF=y
BR2_PACKAGE_LINUX_TOOLS_CPUPOWER=y
BR2_PACKAGE_ALSA_UTILS=y
BR2_PACKAGE_ALSA_UTILS_APLAY=y
BR2_PACKAGE_ALSA_UTILS_SPEAKER_TEST=y
BR2_PACKAGE_FFMPEG=y
BR2_PACKAGE_FFMPEG_GPL=y
BR2_PACKAGE_FFMPEG_FFPLAY=y
BR2_PACKAGE_FFMPEG_FFPROBE=y
BR2_PACKAGE_FFMPEG_POSTPROC=y
BR2_PACKAGE_JACK1=y
BR2_PACKAGE_LAME=y
BR2_PACKAGE_MYTHTV=y
BR2_PACKAGE_MYTHTV_GPL=y
BR2_PACKAGE_MYTHTV_INPUT_JOYSTICK_MENU=y
BR2_PACKAGE_MYTHTV_INPUT_LIRC=y
BR2_PACKAGE_LIBCEC=y
BR2_PACKAGE_LIBV4L=y
BR2_PACKAGE_MYTHTV_INPUT_SATIP=y
BR2_PACKAGE_MYTHTV_INPUT_FIREWIRE=y
BR2_PACKAGE_MYTHTV_INPUT_DVB=y
BR2_PACKAGE_LIBHDHOMERUN=y
BR2_PACKAGE_MYTHTV_INPUT_VBOX=y
BR2_PACKAGE_MYTHTV_INPUT_CETON=y
BR2_PACKAGE_MYTHTV_INPUT_ASI=y
BR2_PACKAGE_MYTHTV_VIDEO_OUTPUT_VULKAN=y
BR2_PACKAGE_MYTHTV_VIDEO_OUTPUT_MHEG=y
BR2_PACKAGE_LIBASS=y
BR2_PACKAGE_PULSEAUDIO=y
BR2_PACKAGE_MYTHTV_MISC_LIXML2=y
BR2_PACKAGE_AVAHI=y
BR2_PACKAGE_MYTHTV_MISC_LIBCRYPTO=y
BR2_PACKAGE_LIBEXIV=y
BR2_PACKAGE_MYTHTV_EXTERNAL_CODEC_OPTIONS=y
BR2_PACKAGE_X264=y
BR2_PACKAGE_x265=y
BR2_PACKAGE_MYTHTV_BINDINGS=y
BR2_PACKAGE_PERL=y
BR2_PACKAGE_XZ=y
BR2_PACKAGE_CIFS_UTILS=y
BR2_PACKAGE_E2FSPROGS=y
BR2_PACKAGE_E2FSPROGS_RESIZE2FS=y
BR2_PACKAGE_XFSPROGS=y
BR2_PACKAGE_LIBERATION=y
# BR2_PACKAGE_LIBERATION_MONO is not set
# BR2_PACKAGE_LIBERATION_SERIF is not set
BR2_PACKAGE_KMSCUBE=y
BR2_PACKAGE_LIBVA_UTILS=y
BR2_PACKAGE_FBSET=y
BR2_PACKAGE_MESA3D=y
BR2_PACKAGE_MESA3D_GALLIUM_DRIVER_CROCUS=y
BR2_PACKAGE_MESA3D_GALLIUM_DRIVER_I915=y
BR2_PACKAGE_MESA3D_GALLIUM_DRIVER_IRIS=y
BR2_PACKAGE_MESA3D_GALLIUM_DRIVER_ZINK=y
BR2_PACKAGE_MESA3D_VULKAN_DRIVER_INTEL=y
BR2_PACKAGE_MESA3D_VULKAN_DRIVER_VIRTIO=y
BR2_PACKAGE_MESA3D_OPENGL_EGL=y
BR2_PACKAGE_SDL2_KMSDRM=y
BR2_PACKAGE_SDL2_OPENGLES=y
BR2_PACKAGE_SDL2_GFX=y
BR2_PACKAGE_SDL2_IMAGE=y
BR2_PACKAGE_SDL2_MIXER=y
BR2_PACKAGE_SDL2_NET=y
BR2_PACKAGE_SDL2_TTF=y
BR2_PACKAGE_VULKAN_TOOLS=y
BR2_PACKAGE_QT5=y
BR2_PACKAGE_QT5BASE_SQLITE_QT=y
BR2_PACKAGE_QT5BASE_OPENGL_LIB=y
BR2_PACKAGE_QT5BASE_VULKAN=y
BR2_PACKAGE_QT5BASE_LINUXFB=y
BR2_PACKAGE_QT5BASE_HARFBUZZ=y
BR2_PACKAGE_QT5BASE_GIF=y
BR2_PACKAGE_QT5BASE_JPEG=y
BR2_PACKAGE_QT5BASE_PNG=y
BR2_PACKAGE_QT5BASE_DBUS=y
BR2_PACKAGE_LINUX_FIRMWARE=y
BR2_PACKAGE_LINUX_FIRMWARE_I915=y
BR2_PACKAGE_LINUX_FIRMWARE_IBT=y
BR2_PACKAGE_LINUX_FIRMWARE_ATHEROS_7010=y
BR2_PACKAGE_LINUX_FIRMWARE_ATHEROS_9170=y
BR2_PACKAGE_LINUX_FIRMWARE_ATHEROS_9271=y
BR2_PACKAGE_LINUX_FIRMWARE_ATHEROS_10K_QCA9377=y
BR2_PACKAGE_LINUX_FIRMWARE_ATHEROS_10K_QCA998X=y
BR2_PACKAGE_LINUX_FIRMWARE_IWLWIFI_100=y
BR2_PACKAGE_LINUX_FIRMWARE_IWLWIFI_105=y
BR2_PACKAGE_LINUX_FIRMWARE_IWLWIFI_135=y
BR2_PACKAGE_LINUX_FIRMWARE_IWLWIFI_1000=y
BR2_PACKAGE_LINUX_FIRMWARE_IWLWIFI_2000=y
BR2_PACKAGE_LINUX_FIRMWARE_IWLWIFI_2030=y
BR2_PACKAGE_LINUX_FIRMWARE_IWLWIFI_22000=y
BR2_PACKAGE_LINUX_FIRMWARE_IWLWIFI_22260=y
BR2_PACKAGE_LINUX_FIRMWARE_IWLWIFI_3160=y
BR2_PACKAGE_LINUX_FIRMWARE_IWLWIFI_3168=y
BR2_PACKAGE_LINUX_FIRMWARE_IWLWIFI_3945=y
BR2_PACKAGE_LINUX_FIRMWARE_IWLWIFI_4965=y
BR2_PACKAGE_LINUX_FIRMWARE_IWLWIFI_5000=y
BR2_PACKAGE_LINUX_FIRMWARE_IWLWIFI_6000G2A=y
BR2_PACKAGE_LINUX_FIRMWARE_IWLWIFI_6000G2B=y
BR2_PACKAGE_LINUX_FIRMWARE_IWLWIFI_7260=y
BR2_PACKAGE_LINUX_FIRMWARE_IWLWIFI_7265D=y
BR2_PACKAGE_LINUX_FIRMWARE_IWLWIFI_8000C=y
BR2_PACKAGE_LINUX_FIRMWARE_IWLWIFI_8265=y
BR2_PACKAGE_LINUX_FIRMWARE_IWLWIFI_9XXX=y
BR2_PACKAGE_LINUX_FIRMWARE_IWLWIFI_6E=y
BR2_PACKAGE_LINUX_FIRMWARE_IWLWIFI_QUZ=y
BR2_PACKAGE_LINUX_FIRMWARE_QUALCOMM_6174=y
BR2_PACKAGE_LINUX_FIRMWARE_RALINK_RT73=y
BR2_PACKAGE_LINUX_FIRMWARE_RALINK_RT2XX=y
BR2_PACKAGE_LINUX_FIRMWARE_RTL_81XX=y
BR2_PACKAGE_LINUX_FIRMWARE_RTL_87XX=y
BR2_PACKAGE_LINUX_FIRMWARE_RTL_88XX=y
BR2_PACKAGE_LINUX_FIRMWARE_RTL_815X=y
BR2_PACKAGE_LINUX_FIRMWARE_RTL_8169=y
BR2_PACKAGE_LINUX_FIRMWARE_XCx000=y
BR2_PACKAGE_LINUX_FIRMWARE_QAT_DH895XCC=y
BR2_PACKAGE_LINUX_FIRMWARE_QAT_C3XXX=y
BR2_PACKAGE_LINUX_FIRMWARE_QAT_C62X=y
BR2_PACKAGE_LINUX_FIRMWARE_USB_SERIAL_TI=y
BR2_PACKAGE_LINUX_FIRMWARE_CX231XX=y
BR2_PACKAGE_LINUX_FIRMWARE_CX23885=y
BR2_PACKAGE_ACPID=y
BR2_PACKAGE_CRYPTSETUP=y
BR2_PACKAGE_DMIDECODE=y
BR2_PACKAGE_GPTFDISK=y
BR2_PACKAGE_GPTFDISK_GDISK=y
BR2_PACKAGE_GPTFDISK_SGDISK=y
BR2_PACKAGE_HDDTEMP=y
BR2_PACKAGE_HDPARM=y
BR2_PACKAGE_HWDATA=y
BR2_PACKAGE_HWDATA_PNP_IDS=y
BR2_PACKAGE_INTEL_MICROCODE=y
BR2_PACKAGE_LM_SENSORS=y
BR2_PACKAGE_LM_SENSORS_SENSORS_DETECT=y
BR2_PACKAGE_NVME=y
BR2_PACKAGE_RTC_TOOLS=y
BR2_PACKAGE_RTL8188EU=y
BR2_PACKAGE_RTL8189ES=y
BR2_PACKAGE_PERL_DATE_MANIP=y
BR2_PACKAGE_PERL_IO_INTERFACE=y
BR2_PACKAGE_PERL_LWP_PROTOCOL_HTTPS=y
BR2_PACKAGE_PERL_NETADDR_IP=y
BR2_PACKAGE_PYTHON3_PY_PYC=y
# BR2_PACKAGE_ALSA_LIB_ALOAD is not set
# BR2_PACKAGE_ALSA_LIB_ALISP is not set
# BR2_PACKAGE_ALSA_LIB_OLD_SYMBOLS is not set
# BR2_PACKAGE_ALSA_LIB_TOPOLOGY is not set
BR2_PACKAGE_LIBVORBIS=y
BR2_PACKAGE_MARIADB_SERVER=y
BR2_PACKAGE_INTEL_MEDIASDK=y
BR2_PACKAGE_INTEL_VPL_GPU_RT=y
BR2_PACKAGE_LIBDRM_RADEON=y
BR2_PACKAGE_LIBDRM_AMDGPU=y
BR2_PACKAGE_LIBVA_INTEL_DRIVER=y
BR2_PACKAGE_LIBINPUT=y
BR2_PACKAGE_LIBUSB=y
BR2_PACKAGE_LIBV4L_UTILS=y
BR2_PACKAGE_LIBXKBCOMMON=y
BR2_PACKAGE_LIBXKBCOMMON_TOOLS=y
BR2_PACKAGE_LIBDVDNAV=y
BR2_PACKAGE_LIBVPX=y
BR2_PACKAGE_X264_CLI=y
BR2_PACKAGE_X265=y
BR2_PACKAGE_X265_CLI=y
BR2_PACKAGE_LIBTIRPC=y
BR2_PACKAGE_CMOCKA=y
BR2_PACKAGE_MOBILE_BROADBAND_PROVIDER_INFO=y
BR2_PACKAGE_BRIDGE_UTILS=y
BR2_PACKAGE_CHRONY=y
BR2_PACKAGE_CRDA=y
BR2_PACKAGE_DNSMASQ=y
BR2_PACKAGE_ETHTOOL=y
BR2_PACKAGE_HOSTAPD=y
BR2_PACKAGE_HOSTAPD_WPA3=y
BR2_PACKAGE_IPTABLES=y
BR2_PACKAGE_IPUTILS=y
BR2_PACKAGE_IW=y
BR2_PACKAGE_LIGHTTPD=y
BR2_PACKAGE_NET_TOOLS=y
BR2_PACKAGE_NETWORK_MANAGER=y
BR2_PACKAGE_NETWORK_MANAGER_TUI=y
BR2_PACKAGE_NETWORK_MANAGER_CLI=y
BR2_PACKAGE_NMAP=y
BR2_PACKAGE_NTP=y
BR2_PACKAGE_NTP_SNTP=y
# BR2_PACKAGE_NTP_NTPD is not set
BR2_PACKAGE_OPENSSH=y
BR2_PACKAGE_RSYNC=y
BR2_PACKAGE_WGET=y
BR2_PACKAGE_WIREGUARD_TOOLS=y
BR2_PACKAGE_WIRELESS_TOOLS=y
BR2_PACKAGE_WIRELESS_TOOLS_IFRENAME=y
BR2_PACKAGE_WIRELESS_TOOLS_LIB=y
BR2_PACKAGE_WPA_SUPPLICANT=y
BR2_PACKAGE_WPA_SUPPLICANT_WEXT=y
BR2_PACKAGE_WPA_SUPPLICANT_AP_SUPPORT=y
BR2_PACKAGE_WPA_SUPPLICANT_WIFI_DISPLAY=y
BR2_PACKAGE_WPA_SUPPLICANT_MESH_NETWORKING=y
BR2_PACKAGE_WPA_SUPPLICANT_OVERRIDES=y
BR2_PACKAGE_WPA_SUPPLICANT_AUTOSCAN=y
BR2_PACKAGE_WPA_SUPPLICANT_HOTSPOT=y
BR2_PACKAGE_WPA_SUPPLICANT_WPS=y
BR2_PACKAGE_WPA_SUPPLICANT_WPA3=y
BR2_PACKAGE_WPA_SUPPLICANT_CLI=y
BR2_PACKAGE_WPA_SUPPLICANT_WPA_CLIENT_SO=y
BR2_PACKAGE_WPA_SUPPLICANT_PASSPHRASE=y
BR2_PACKAGE_WPA_SUPPLICANT_DBUS=y
BR2_PACKAGE_WPA_SUPPLICANT_DBUS_INTROSPECTION=y
BR2_PACKAGE_FILE=y
BR2_PACKAGE_LOGROTATE=y
BR2_PACKAGE_NEOFETCH=y
BR2_PACKAGE_SCREEN=y
BR2_PACKAGE_SUDO=y
BR2_PACKAGE_TMUX=y
BR2_PACKAGE_BTOP=y
BR2_PACKAGE_COREUTILS=y
BR2_PACKAGE_HTOP=y
BR2_PACKAGE_SYSTEMD_EFI=y
BR2_PACKAGE_SYSTEMD_BACKLIGHT=y
BR2_PACKAGE_SYSTEMD_LOCALED=y
BR2_PACKAGE_SYSTEMD_POLKIT=y
BR2_PACKAGE_SYSTEMD_RFKILL=y
BR2_PACKAGE_TAR=y
BR2_PACKAGE_UTIL_LINUX_BINARIES=y
BR2_PACKAGE_UTIL_LINUX_EJECT=y
BR2_PACKAGE_UTIL_LINUX_HWCLOCK=y
BR2_PACKAGE_UTIL_LINUX_KILL=y
BR2_PACKAGE_UTIL_LINUX_LOSETUP=y
BR2_PACKAGE_UTIL_LINUX_MORE=y
BR2_PACKAGE_UTIL_LINUX_PARTX=y
BR2_PACKAGE_UTIL_LINUX_ZRAMCTL=y
BR2_PACKAGE_NANO=y
BR2_PACKAGE_VIM=y
BR2_TARGET_ROOTFS_EXT2=y
BR2_TARGET_ROOTFS_EXT2_4=y
BR2_TARGET_ROOTFS_EXT2_SIZE="2000M"
BR2_TARGET_ROOTFS_EXT2_RESBLKS=1
# BR2_TARGET_ROOTFS_TAR is not set
BR2_TARGET_GRUB2=y
BR2_TARGET_GRUB2_X86_64_EFI=y
BR2_TARGET_GRUB2_INSTALL_TOOLS=y
BR2_TARGET_SHIM=y
BR2_PACKAGE_HOST_DOSFSTOOLS=y
BR2_PACKAGE_HOST_GENIMAGE=y
BR2_PACKAGE_HOST_KMOD_XZ=y
BR2_PACKAGE_HOST_MTOOLS=y
BR2_PACKAGE_LIBEVDEV=y
```

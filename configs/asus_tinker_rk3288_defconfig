## package/mythtv/Config.in
```kconfig
config BR2_PACKAGE_MYTHTV_ARCH_SUPPORTS
	bool
	default y if BR2_PACKAGE_FFMPEG_ARCH_SUPPORTS
	
#comment "mythtv needs a glibc toolchain w/ C++, threads, wchar, dynamic library, gcc >= 9.x, host gcc >= 9.x"
#	depends on BR2_PACKAGE_MYTHTV_ARCH_SUPPORTS
#	depends on BR2_TOOLCHAIN_HAS_SYNC_4
#	depends on !BR2_INSTALL_LIBSTDCPP || !BR2_TOOLCHAIN_HAS_THREADS \
#		|| !BR2_USE_WCHAR || !BR2_SHARED_LIBS \
#		|| !BR2_TOOLCHAIN_GCC_AT_LEAST_9 \
#		|| !BR2_HOST_GCC_AT_LEAST_9 \
#		|| BR2_TOOLCHAIN_USES_MUSL \
#		|| BR2_TOOLCHAIN_USES_UCLIBC


#validated for mythtv v35 only
menuconfig BR2_PACKAGE_MYTHTV
	bool "mythtv"
	depends on BR2_PACKAGE_MYTHTV_ARCH_SUPPORTS
	select BR2_PACKAGE_QT5BASE
	select BR2_PACKAGE_QT5BASE_CONCURRENT
	select BR2_PACKAGE_QT5BASE_FONTCONFIG
	select BR2_PACKAGE_QT5BASE_GUI
	select BR2_PACKAGE_QT5BASE_WIDGETS
	select BR2_PACKAGE_QT5BASE_OPENGL
	select BR2_PACKAGE_QT5BASE_SQL
	select BR2_PACKAGE_QT5BASE_MYSQL	
	select BR2_PACKAGE_TAGLIB
	select BR2_PACKAGE_LIBZIP
	select BR2_PACKAGE_LIBSAMPLERATE
	select BR2_PACKAGE_LIBSOUNDTOUCH
	select BR2_PACKAGE_LIBZIP
	select BR2_PACKAGE_LZO
	help
	   mythtv 

if BR2_PACKAGE_MYTHTV
	
config BR2_PACKAGE_MYTHTV_GPL
	bool "Enable GPL code"
	help
	  allow use of GPL code, the resulting libs and binaries will
	  be under GPL

config BR2_PACKAGE_MYTHTV_NONFREE
	bool "Enable nonfree code"
	help
	  allow use of nonfree code, the resulting libs and binaries
	  will be unredistributable


config BR2_PACKAGE_MYTHTV_FFMPEG
	bool "Build ffmpeg (the command line application)"
	help
	  ffmpeg is a very fast video and audio converter.
	  It can also grab from a live audio/video source.

if BR2_PACKAGE_MYTHTV_FFMPEG

config BR2_PACKAGE_MYTHTV_FFMPEG_FFPLAY
	bool "Build ffplay"
	depends on !BR2_STATIC_LIBS # sdl2
	select BR2_PACKAGE_SDL2
	help
	  FFplay is a very simple and portable media player using the
	  mythtv libraries and the SDL library.
	  It is mostly used as a testbed for the various mythtv APIs.

comment "ffplay needs a toolchain w/ dynamic library"
	depends on BR2_STATIC_LIBS


config BR2_PACKAGE_MYTHTV_FFMPEG_FFPROBE
	bool "Build ffprobe"
	help
	  FFprobe is a utility to determine the audio and video
	  characteristics of a container file.
endif



config BR2_PACKAGE_MYTHTV_INPUT
	bool "Input Support"
	default y
	#prompt "Mythtv Input Devices"

if BR2_PACKAGE_MYTHTV_INPUT

config  BR2_PACKAGE_MYTHTV_INPUT_JOYSTICK_MENU
	bool "Build joystick_menu support"
	help
	  Optional mythtv hw input device

config BR2_PACKAGE_MYTHTV_INPUT_LIRC
	bool "Build lirc support"
	help
	  Optional mythtv hw input device

config BR2_PACKAGE_LIBCEC
	bool "Build libCEC support"
	help
	  Optional mythtv hw input device

config BR2_PACKAGE_LIBV4L
	bool "Build v4l2 support"
	help
	   Build v4l2 support

config BR2_PACKAGE_MYTHTV_INPUT_SATIP
	bool "Build Sat IP support"
	help
	  Optional mythtv hw input device

config BR2_PACKAGE_MYTHTV_INPUT_FIREWIRE
	bool "Build firewire support"
	help
	  Optional mythtv hw input device

config BR2_PACKAGE_MYTHTV_INPUT_DVB
	bool "Build dvb support"
	help
	  Optional mythtv hw input device

config BR2_PACKAGE_LIBHDHOMERUN
	bool "Build libhdhomerun support"
	help
	  Optional mythtv hw input device

config BR2_PACKAGE_MYTHTV_INPUT_VBOX
	bool "Build vbox support"
	help
	  Optional mythtv hw input device

config BR2_PACKAGE_MYTHTV_INPUT_CETON
	bool "Build ceton support"
	help
	  Optional mythtv hw input device

config BR2_PACKAGE_MYTHTV_INPUT_ASI
	bool "Build asi support"
	help
	  Optional mythtv hw input device
endif


config BR2_PACKAGE_MYTHTV_VIDEO_OUTPUT
	select BR2_PACKAGE_MYTHTV_VIDEO_OUTPUT_DRM
	bool "Video Output Support"
	default y

if BR2_PACKAGE_MYTHTV_VIDEO_OUTPUT

	
config BR2_PACKAGE_MYTHTV_VIDEO_OUTPUT_X11
       bool "Build x11/xrandr support"
	help
	  x11/xrandr support
	
config  BR2_PACKAGE_MYTHTV_VIDEO_OUTPUT_VAAPI
         bool "Build vaapi support"
	 depends on BR2_PACKAGE_MYTHTV_VIDEO_OUTPUT_X11
	 help
	   vaapi support

config  BR2_PACKAGE_MYTHTV_VIDEO_OUTPUT_VDPAU
         bool "Build vdpau support"
	 depends on BR2_PACKAGE_MYTHTV_VIDEO_OUTPUT_X11
	 help
	   vdpau support
	
config  BR2_PACKAGE_MYTHTV_VIDEO_OUTPUT_DRM
	 select BR2_PACKAGE_LIBDRM
         bool "Build DRM support"
	 default y
	 help
	   drm support


#config  BR2_PACKAGE_MYTHTV_MISC_DRM_QT_INTEGRATION
#         bool "Build DRM QT Integration support"
#	 select BR2_PACKAGE_MYTHTV_VIDEO_OUTPUT_DRM
#	 help
#	   	drm qt integration support
#
#config  BR2_PACKAGE_MYTHTV_MISC_WAYLAND_EXTRAS
#         bool "Build Wayland Extras support"
#	 depends on BR2_PACKAGE_MYTHTV_MISC_DRM_QT_INTEGRATION
#	 help
#		Wayland Extras


#opengl is a required dep
config  BR2_PACKAGE_MYTHTV_VIDEO_OUTPUT_OPENGL
         bool "Build OpenGL support"
	 default y
	 help
	   OpenGL support

config  BR2_PACKAGE_MYTHTV_VIDEO_OUTPUT_EGL
	 select BR2_PACKAGE_MESA3D_OPENGL_ES
	 select BR2_PACKAGE_QT5BASE_EGLFS
	 select BR2_PACKAGE_QT5BASE_OPENGL_ES2
         bool "Build EGL support"
	 default y
	 help
	   EGL support

config  BR2_PACKAGE_MYTHTV_VIDEO_OUTPUT_VULKAN
         bool "Build Vulkan support"
	 help
	    Vulkan support

config  BR2_PACKAGE_MYTHTV_VIDEO_OUTPUT_MHEG
         bool "Build MHEG support"
	 help
	   MHEG support

config  BR2_PACKAGE_LIBASS
         bool "Build libass support"
	 help
	   libass subtitle support
	
endif


config BR2_PACKAGE_MYTHTV_SOUND_OUTPUT
	bool "SOUND Output Support"
	default y

if BR2_PACKAGE_MYTHTV_SOUND_OUTPUT


# config  BR2_PACKAGE_MYTHTV_SOUND_OUTPUT_PIPEWIRE
#         bool "Build Pipewire support"
#	  help
#	    Pipewire support

config  BR2_PACKAGE_PULSEAUDIO
         bool "Build PulseAudio support"
	 help
	   PulseAudio support

config  BR2_PACKAGE_MYTHTV_SOUND_OUTPUT_OSS
         bool "Build OSS support"
	 default y
	 help
	   OSS support
	
config  BR2_PACKAGE_ALSA_LIB
         bool "Build ALSA support"
	 help
	   ALSA support

config  BR2_PACKAGE_JACK1
         bool "Build JACK support"
	 help
	   JACK support
endif


if BR2_PACKAGE_MYTHTV_MISC

config  BR2_PACKAGE_MYTHTV_MISC_LIXML2
         bool "Build libxml2 support"
	 help
	   libxml2 support
	
config  BR2_PACKAGE_AVAHI_LIBDNSSD_COMPATIBILITY
         bool "Build libdns_sd(Bonjour) support"
	 help
           libdns_sd(Bonjour) support

config  BR2_PACKAGE_MYTHTV_MISC_LIBCRYPTO
         bool "Build libcrypto support"
	 help
	   libcrypto support

config  BR2_PACKAGE_GNUTLS
	 bool "Build gnutls support"
	 help
	   gnuutls support

config  BR2_PACKAGE_LIBEXIV
         bool "Build libexiv support"
	 help
           libexiv support

#this is required dep
config  BR2_PACKAGE_LIBBLURAY
         bool "Build bluray support"
	 default y
	 help
           bluray support

config  BR2_PACKAGE_MYTHTV_MISC_SYSTEMD_NOTIFY
         bool "Build systemd_notify support"
	 select BR2_INIT_SYSTEMD 
	 help
           systemd_notify support

config  BR2_PACKAGE_MYTHTV_MISC_SYSTEMD_JOURNAL
         bool "Build systemd_journal support"
	 select BR2_INIT_SYSTEMD 
	 help
           systemd_journal support
endif


config BR2_PACKAGE_MYTHTV_EXTERNAL_CODEC_OPTIONS
	bool "External Codec Options"

if BR2_PACKAGE_MYTHTV_EXTERNAL_CODEC_OPTIONS

config  BR2_PACKAGE_LAME
         bool "Build mp3lame support"
	 help
	   mp3lame support

config  BR2_PACKAGE_MYTHTV_EXTERNAL_CODEC_OPTIONS_XVID
         bool "Build xvid support"
	 help
	   xvid support

config  BR2_PACKAGE_X264
         bool "Build x264 support"
	 help
	   x264 support

config  BR2_PACKAGE_x265
         bool "Build x265 (HEVC) support"
	 help
	   "x265 (HEVC) support"

config  BR2_PACKAGE_LIBAOM
         bool "Build libaom (AV1) support"
	 help
	   "aom (AV1) support"

config  BR2_PACKAGE_DAV1D
         bool "Build libdav1d (AV1) support"
	 help
	   "libdav1d (AV1) support"
endif

	 
config BR2_PACKAGE_MYTHTV_BINDINGS
	bool "Bindings"

if BR2_PACKAGE_MYTHTV_BINDINGS

config  BR2_PACKAGE_PERL
        bool "Build perl bindings support"
	select BR2_PACKAGE_HOST_PERL
	select BR2_PACKAGE_HOST_PERL_DATE_MANIP
	select BR2_PACKAGE_HOST_PERL_DBI
	select BR2_PACKAGE_PERL_DBI
	select BR2_PACKAGE_HOST_PERL_DBD_MYSQL
	select BR2_PACKAGE_PERL_DBD_MYSQL
	select BR2_PACKAGE_PERL_HTTP_DATE
	select BR2_PACKAGE_PERL_HTTP_MESSAGE
	select BR2_PACKAGE_HOST_PERL_SOCKET6
	select BR2_PACKAGE_HOST_PERL_IO_SOCKET_INET6
	select BR2_PACKAGE_PERL_IO_SOCKET_INET6
	select BR2_PACKAGE_HOST_LIBWWW_PERL
	select BR2_PACKAGE_PERL_LIBWWW_PERL
	select BR2_PACKAGE_HOST_PERL_NET_UPNP
	select BR2_PACKAGE_PERL_NET_UPNP
	select BR2_PACKAGE_HOST_PERL_XML_SIMPLE
	select BR2_PACKAGE_PERL_XML_SIMPLE
	select BR2_PACKAGE_HOST_PERL_MODULE_BUILD
	select BR2_PACKAGE_PERL_MODULE_BUILD
	 help
	   Optional mythtv perl bindings

config  BR2_PACKAGE_PHP
        bool "Build php bindings support"
	help
	  Optional mythtv binding

config  BR2_PACKAGE_PYTHON
        bool "Build python bindings support"
	#select BR2_PACKAGE_PYTHON3
        help
          Optional mythtv binding
endif

config BR2_PACKAGE_MYTHTV_EXTRACONF
	string "Additional parameters for ./configure"
	default ""
	help
	  Extra parameters that will be appended to mythtv's
	  ./configure commandline.

if BR2_PACKAGE_MYTHTV
source "package/mythtv/mythplugins/Config.in"
endif

endif
```

## package/mythtv/mythplugins/Config.in
```kconfig
menuconfig BR2_PACKAGE_MYTHTV_MYTHPLUGINS
	bool "mythplugins"
	depends on BR2_PACKAGE_MYTHTV
	help
	   mythplugins

if BR2_PACKAGE_MYTHTV_MYTHPLUGINS

config BR2_PACKAGE_MYTHTV_MYTHPLUGINS_PLUGIN1
	bool "Build plugin1"
	#depends on 
	#select BR2_PACKAGE_x
	help
	  Plugin1 Description

comment "plugin1 comment"
	#depends on BR2_STATIC_LIBS

config BR2_PACKAGE_MYTHTV_MYTHPLUGINS_PLUGIN2
	bool "Build plugin2"
	#depends on 
	#select BR2_PACKAGE_x
	help
	  Plugin2 Description

comment "plugin2 comment"
	#depends on BR2_STATIC_LIBS

config BR2_PACKAGE_MYTHTV_MYTHPLUGINS_PLUGIN3
	bool "Build plugin3"
	#depends on 
	#select BR2_PACKAGE_x
	help
	  Plugin3 Description

comment "plugin3 comment"
	#depends on BR2_STATIC_LIBS



config BR2_PACKAGE_MYTHTV_MYTHPLUGINS_PLUGIN4
	bool "Build plugin4"
	#depends on 
	#select BR2_PACKAGE_x
	help
	  Plugin4 Description

comment "plugin4 comment"
	#depends on BR2_STATIC_LIBS

endif
```

## package/perl-io-interface/Config.in
```kconfig
config BR2_PACKAGE_PERL_IO_INTERFACE
	bool "perl-io-interface"
	depends on !BR2_STATIC_LIBS
	select BR2_PACKAGE_PERL_MODULE_BUILD
	help
	  Access and modify network interface card configuration.

	  https://metacpan.org/release/IO-Interface

comment "perl-io-interface needs a toolchain w/ dynamic library"
	depends on BR2_STATIC_LIBS
```

## package/perl-io-socket-inet6/Config.in
```kconfig
config BR2_PACKAGE_PERL_IO_SOCKET_INET6
	bool "perl-io-socket-inet6"
	depends on !BR2_STATIC_LIBS
	select BR2_PACKAGE_PERL_IO_INTERFACE # runtime
	help
	   "Object interface for AF_INET/AF_INET6 domain sockets"	

comment "perl-io-socket-inet6 needs a toolchain w/ dynamic library"
	depends on BR2_STATIC_LIBS
```

## package/perl-module-build/Config.in
```kconfig
config BR2_PACKAGE_PERL_MODULE_BUILD
	bool "perl-module-build"
	help
	  module build

	  https://metacpan.org/dist/Module-Build
```

## package/perl-net-upnp/Config.in
```kconfig
config BR2_PACKAGE_PERL_NET_UPNP
	bool "perl-net-upnp"
	help
	  Control interface to UPnP.

	  https://metacpan.org/release/Net-UPnP
```

## package/perl-socket6/Config.in
```kconfig
config BR2_PACKAGE_PERL_SOCKET6
	bool "perl-socket6"
	depends on !BR2_STATIC_LIBS
	depends on BR2_PACKAGE_HOST_PERL_BUILD_MODULE
	select BR2_PACKAGE_PERL_IO_INTERFACE # runtime
	help
	   "Object interface for domain sockets"	

comment "perl-socket6 needs a toolchain w/ dynamic library"
	depends on BR2_STATIC_LIBS
```

## package/perl-xml-parser/Config.in
```kconfig
config BR2_PACKAGE_PERL_XML_PARSER
	bool "perl-xml-parser"
	depends on !BR2_STATIC_LIBS
	select BR2_PACKAGE_LIBXML2
	select BR2_PACKAGE_ZLIB
	select BR2_PACKAGE_PERL_XML_NAMESPACESUPPORT # runtime
	select BR2_PACKAGE_PERL_XML_SAX # runtime
	select BR2_PACKAGE_PERL_XML_SAX_BASE # runtime
	select BR2_PACKAGE_PERL_XML_SAX_EXPAT # runtime
	select BR2_PACKAGE_EXPAT
	help
	   xml parsing.


comment "perl-xml-parser needs a toolchain w/ dynamic library"
	depends on BR2_STATIC_LIBS
```

## package/perl-xml-sax-expat/Config.in
```kconfig
config BR2_PACKAGE_PERL_XML_SAX_EXPAT
	bool "perl-xml-sax-expat"
	help
	  Implementation of a SAX2 driver sitting on top of Expat. 

	  https://metacpan.org/release/XML-SAX-Expat
```

## package/perl-xml-simple/Config.in
```kconfig
config BR2_PACKAGE_PERL_XML_SIMPLE
	bool "perl-xml-simple"
	depends on !BR2_STATIC_LIBS
	select BR2_PACKAGE_LIBXML2
	select BR2_PACKAGE_ZLIB
	select BR2_PACKAGE_PERL_XML_NAMESPACESUPPORT # runtime
	select BR2_PACKAGE_PERL_XML_SAX # runtime
	select BR2_PACKAGE_PERL_XML_SAX_BASE # runtime
	select BR2_PACKAGE_PERL_XML_SAX_EXPAT # runtime
	help
	  Interface to libxml2 xml parsing and DOM library.


comment "perl-xml-simple needs a toolchain w/ dynamic library"
	depends on BR2_STATIC_LIBS
```

## package/perl/Config.in.host
```kconfig
config BR2_PACKAGE_HOST_PERL
	bool "host perl"
	help
	  The perl language interpreter. Host package.

	  http://www.perl.org/

if BR2_PACKAGE_HOST_PERL

config BR2_PACKAGE_HOST_PERL_CLONE
	bool "perl-clone"
	help
	  clone module for host Perl.

config BR2_PACKAGE_HOST_PERL_DATE_MANIP
	bool "perl-date-manip"
	help
	  perl-date-manip module for host Perl.

config BR2_PACKAGE_HOST_PERL_DBD_MYSQL
	bool "perl-dbd-mysql"
	select BR2_PACKAGE_HOST_PERL_DBI
	select BR2_PACKAGE_HOST_PERL_MODULE_BUILD
	help
	help
	  dbd mysql module for host Perl.

config BR2_PACKAGE_HOST_PERL_DBI
	select BR2_PACKAGE_HOST_PERL_MODULE_BUILD
	bool "perl-dbi"
	help
	  dbi module for host Perl

config BR2_PACKAGE_HOST_PERL_HTTP_DATE
	bool "perl-http-date"
	help
	  perl-http-date module for host Perl.

config BR2_PACKAGE_HOST_PERL_HTTP_MESSAGE
	bool "perl-http-message"
	select BR2_PACKAGE_HOST_PERL_MODULE_BUILD
	help
	  http message module for host Perl.

config BR2_PACKAGE_HOST_PERL_MODULE_BUILD
	bool "perl-module-build"
	select BR2_PACKAGE_HOST_PERL_CLONE
	help
	  build module for host Perl.

config BR2_PACKAGE_HOST_PERL_IO_INTERFACE
	bool "perl-io-interface"
	select BR2_PACKAGE_HOST_PERL_MODULE_BUILD
	help
	  IO interfaace module for host Perl.

config BR2_PACKAGE_HOST_PERL_IO_SOCKET_INET6
	bool "perl-io-socket-inet6"
	select BR2_PACKAGE_HOST_PERL_MODULE_BUILD
	select BR2_PACKAGE_HOST_PERL_SOCKET6 
	help
	  "(deprecated) perl-io-socket-inet6 module for host Perl.

config BR2_PACKAGE_HOST_PERL_LIBWWW_PERL
	bool "perl-libwww-perl"
	select BR2_PACKAGE_HOST_PERL_MODULE_BUILD
	help
	  www module for host Perl.

config BR2_PACKAGE_HOST_PERL_MODULE_BUILD
	bool "perl-module-build"
	select BR2_PACKAGE_HOST_PERL_CLONE
	help
	  build module for host Perl.

config BR2_PACKAGE_HOST_PERL_NET_UPNP
	bool "perl-net-upnp"
	select BR2_PACKAGE_HOST_PERL_MODULE_BUILD
	help
	  upnp module for host Perl.

config BR2_PACKAGE_HOST_PERL_SOCKET6
	bool "perl-socket6"
	select BR2_PACKAGE_HOST_PERL_MODULE_BUILD
	#select BR2_PACKAGE_HOST_PERL_IO_INTERFACE
	help
	  socket6 module for host Perl.

config BR2_PACKAGE_HOST_PERL_TRY_TINY
	bool "perl-try-tiny"
	select BR2_PACKAGE_HOST_PERL_MODULE_BUILD
	help
	  try-tiny module for host Perl.

config BR2_PACKAGE_HOST_PERL_URI
	bool "perl-uri"
	select BR2_PACKAGE_HOST_PERL_MODULE_BUILD
	help
	  uri module for host Perl.


config BR2_PACKAGE_HOST_PERL_XML_SIMPLE
	bool "perl-xml-simple"
	select BR2_PACKAGE_HOST_PERL_MODULE_BUILD
	help
	  XML Simple module for host Perl.


endif
```
